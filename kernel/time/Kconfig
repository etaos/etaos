## kernel/time/Kconfig
```kconfig
menuconfig TIMER
	bool "System timers"
	select MALLOC
	help
	  Say 'y' here if you want to build support for
	  system timers. System timers support the system
	  when it comes to timing. The scheduler, virtual
	  timers and the 'jiffy' tick (i.e. system tick) all
	  run on top of this susbystem.

if TIMER
config SYS_TICK
	bool "System tick"
	default y
	help
	  Say 'y' here to enable the system tick (or jiffy timer).
	  This timer is mandatory for all systems within ETA/OS itself
	  that require precision timing (scheduler, etc..). If unsure
	  say 'y'.

config DST_BIAS
	int "DST bias"
	default -3600
	help
	  This is the bias for daylight savings time. This value is
	  substracted from the standard time when adjusting for daylight
	  savings time.

config HRTIMER
	bool "High resolution timers"
	default n
	help
	  Say 'y' here if your application needs high resolution timers
	  (which are generally ran from interrupt context).

config TIMER_DBG
	bool "Timer debugging"
	default n
	help
	  Saying 'y' here enables various debugging messages
	  in the timer subsystem. This option is mostly useful
	  for ETA/OS developers. If you are unsure say 'n' here.
endif

config DELAY_US
	bool "Micro second delay"
	help
	  Say 'y' here to build support for a microsecond delay
	  API function. This is implemented using a loop based delay
	  (i.e. it will loop for X amount of microseconds before
	  passing control back).

config DELAY_MS
	bool "Milisecond delay"
	depends on SYS_TICK
	help
	  Say 'y' here to build an API function to loop delay
	  for a certain amount of miliseconds. This function should
	  be avoided when using the scheduler, since it can derail
	  virtual timers and the scheduler. When using the scheduler
	  use sleep instead.
```

## lib/Kconfig
```kconfig
source "lib/crt/Kconfig"
source "lib/etaos/Kconfig"

menu "Libraries"

config XORLIST
	tristate "Exclusive OR list"
	default m
	help
	  Say 'y' here to built support of the exclusive OR list
	  library.

endmenu
```

## lib/crt/Kconfig
```kconfig
config CRT
	tristate "C runtime library"
	depends on m && VFS
	default m
	help
	  Say 'y' here to build the standard C library. If unsure,
	  say 'y' here.

config EXT_STRING
	bool "Extended string functions"
	depends on CRT
	default n
	help
	  Say 'y' here to build the extended string function library.
```

## lib/etaos/Kconfig
```kconfig
config LIBETAOS
	tristate "ETA/OS C++ runtime"
	depends on CPP && GPIO && ANALOG && SCHED && m
	default n
	help
	  Say 'm' here to build the C++ run time libraries.
```

## lib/stdio/Kconfig
```kconfig
config STDIO
	tristate "STDIO library"
	depends on m
	default m
	select STDLIB
	help
	  Say 'y' here if you want to build the
	  STDIO library, which is part of libc. If
	  unsure say 'y' here.
```

## lib/stdlib/Kconfig
```kconfig
config STDLIB
	tristate "Stardard C library"
	depends on m
	default m
	help
	  Say 'y' here if you want to build the
	  standard C library. If you are unsure
	  say 'y' here.
```

## lib/string/Kconfig
```kconfig
config STRING
	tristate "C string library"
	depends on m
	default m
	help
	  Say 'y' here if you want to build a string
	  manipulation module. Example functions it provides:
	  strlen, strcmp, etc.. If you are unsure say 'm'
	  here.
```

## mm/Kconfig
```kconfig
menu "Memory Allocation"

config MALLOC
	bool
	default n
	help
	  Enable or disable the memory allocator. If you're not
	  sure, say 'Y' here.

config MM_DEBUG
	bool "Memory debugger"
	depends on MALLOC
	help
	  Say 'Y' here if you want to enable the memory
	  allocation debugging code.

config MM_DESTRUCTIVE_ALLOC
	bool "Destructive memory allocation"
	depends on MALLOC
	help
	  Say 'y' here to turn the memory allocator into a
	  destructive allocator. This means that whenever an
	  allocation fails, a kernel panic is thrown up.

config BEST_FIT
	bool "Best fit allocator"
	select MALLOC
	help
	  Say 'y' here to compile the best-fit allocator.

config FIRST_FIT
	bool "First fit allocator"
	select MALLOC
	help
	  Say 'y' here to compile the first-fit allocator.

choice
	prompt "Default allocation algorithm"

config SYS_BF
	bool "Best-fit allocator"
	depends on BEST_FIT
	help
	  Select to use the best-fit allocator as default allocator.

config SYS_FF
	bool "First-fit allocator"
	depends on FIRST_FIT
	help
	  Select the first-fit allocator as default allocator.
endchoice

endmenu
```
