## kernel/python/Kconfig
```kconfig
menuconfig PYTHON
	bool "Python virtual machine (PyMite)"
	help
	  Say 'y' here if you want to let ETA/OS applications
	  use the Python language. Please note that ETA/OS only
	  provides a basic virtual machine, based on the bytecode
	  produced by Python 2.6, and a verry limited standard
	  library.

if PYTHON
if SCHED
config PYTHON_STACK_SIZE
	int "Python runner stack size"
	default 4096
	help
	  The size of the stack, in bytes, running the
	  Python virtual machine.

config PYTHON_PRIO
	int "VM thread priority"
	default 120
	help
	  Priority of the thread running the Python VM.
endif

config PYTHON_HEAP_SIZE
	int "Python heap size"
	default 8192
	help
	  Number of bytes allocated to the Python heap.

config HAVE_SLICE
	bool
	default y

config HAVE_PRINT
	bool "Implement 'print'"
	depends on CRT

config CLASSES
	bool
	depends on CRT
	default y

config HAVE_REPLICATION
	bool "Replication of strings, lists and hashes"
	depends on CRT
	default y

config DEFAULTARGS
	bool "Default method arguments"
	default y

config HAVE_DEL
	bool "'del' keyword"
	default y

config HAVE_BACKTICK
	bool "Support backticking"
	default y

config HAVE_FLOAT
	bool "Support floating point operations"
	default y

config HAVE_GC
	bool "Garbage collection"
	default y

config HAVE_STRING_FORMAT
	bool "String formatting"
	depends on CRT
	default y

config HAVE_ASSERT
	bool "Assert"
	default y

config HAVE_CLOSURES
	bool "Function closures"

config HAVE_GENERATORS
	bool
	depends on HAVE_CLASSES
	default y

config HAVE_IMPORTS
	bool
	default y

config HAVE_BYTEARRAY
	bool "Support bytearray()"

config HAVE_DEBUG_INFO
	bool "Debug info"
	default y
	depends on CRT
	help
	  Say 'y' here to print debug information (stacktraces etc.)
	  when an error / exception occurs. If you are unsure, say 'y'
	  here.
endif
```

## kernel/sched/Kconfig
```kconfig
menuconfig SCHED
	bool "Scheduler"
	depends on CRT
	select TIMER
	select SYS_TICK
	help
	  Say 'y' here if you want to enable the scheduler. The
	  scheduler is responsible for handeling the execution of
	  threads, virtual timers and, if available, SMP processors.
	  If you are unsure say 'n' here.

if SCHED

source "kernel/sched/Kconfig.algo"
source "kernel/sched/Kconfig.core"

config RR_SHARED
	bool
	help
	  Build the shared round robin helpers. These are automatically build
	  for all RR based algorithms.

config RR_ENTITY
	bool

config EVENT_MUTEX
	bool "Event mutexes"
	select THREAD_QUEUE
	help
	  Enable to build more efficient mutexes, using
	  the scheduler to queue threads in a mutex. After
	  a signal has been given (from either IRQ or non-IRQ
	  context) the thread will be released into the run queue
	  again. If unsure say 'y' here.

config IPM
	bool "Inter-Process Messages"
	depends on EVENT_MUTEX
	help
	  Build support for IPM (Inter-Process Messages) if you say
	  'y' here. IPM can be used to communicate between different
	  threads which might also be running on another CPU.

config SCHED_DBG
	bool "Scheduling DBG"
	help
	  Say 'y' here to enable the scheduling debugger. This
	  function is only useful for ETAO/OS developers. If you
	  are unsure say 'n' here.
endif
```

## kernel/sched/Kconfig.algo
```kconfig
# Scheduling algo options

menu "Scheduling algorithms"

config EDF
	bool "(Virtual) Earliest Deadline First"
	select RR_SHARED
	select RR_ENTITY
	help
	  Say 'y' here to build the Earliest Deadline First algorithm.

config RR
	bool "Round robin scheduler"
	select RR_SHARED
	select RR_ENTITY
	help
	  Say 'y' here to use the round robin algorithm to
	  schedule different threads.

config FIFO
	bool "FIFO scheduler"
	select RR_SHARED
	select RR_ENTITY
	help
	  Say 'y' here to use the FIFO scheduling algorithm to
	  schedule threads. The FIFO scheduler does not take
	  priorities into account when scheduling new threads.
	  The queue's are sorted with the time of insertion used
	  as the sorting key.

config LOTTERY
	bool "Lottery scheduler"
	select RR_SHARED
	select RR_ENTITY
	help
	  Say 'y'here to build the lottery scheduler. The lottery
	  scheduler depends on random number generation to pick
	  threads in a 'fair' way.

endmenu

choice
	prompt "Default algorithm"
	help
	  Select the default scheduling policy.

config SYS_EDF
	bool "Earliest deadline first scheduler"
	depends on EDF

config SYS_RR
	bool "Round robin scheduler"
	depends on RR

config SYS_FIFO
	bool "FIFO scheduler"
	depends on FIFO

config SYS_LOTTERY
	bool "Lottery scheduler"
	depends on LOTTERY

endchoice
```

## kernel/sched/Kconfig.core
```kconfig
# Core scheduler options

config SQS
	bool "Single queue scheduler"
	default y
	help
	  Say 'y' here to use a single run queue, even if multiple CPU
	  cores are present. On lower end CPU's this generally produces better
	  throughput. If you're unsure, say 'y' here.

config THREAD_QUEUE
	bool "Thread queues"
	select FIFO
	help
	  Enable support for thread queue's by saying 'y' here.
	  Thread queue's are a storage mechanism for threads using
	  the default scheduling policy as its storage mechanism.
	  You can select a storage mechanism (aka scheduling
	  algorithm) above.


config DYN_PRIO
	bool "Dynamic priorities"
	depends on SYS_RR && !SYS_EDF
	help
	  Say 'y' here to enable dynamic priorities. Dynamic
	  priorities are an extra set of priorites set by
	  the scheduler to make the scheduling process more fair
	  and reduce the chance that 2 high priority threads
	  dead swap the entire scheduling system. If you are
	  unsure say 'y' here.

choice
	prompt "Mutex lock mechanism"

config MUTEX_TRADITIONAL
	bool "Traditional mutexes"
	help
	  Say 'y' here to use the traditional mutex
	  locking mechanism.
	  This mechanism is a bit more sensitive to
	  deadlocks then the event queue mechanism.

config MUTEX_EVENT_QUEUE
	bool "Event queue mutex"
	depends on EVENT_MUTEX
	help
	  Say 'y' if you are interrested in using
	  event queue's as the backend for mutex
	  locks. These mechanism provides better
	  use of the CPU time, by using the scheduler
	  to run other threads when waiting for a lock.
	  The downside is, that the memory usage is
	  slightly higher and a bit more overhead when
	  locking/unlocking.

endchoice

config SEM
	bool "Semaphores"
	depends on EVENT_MUTEX
	help
	  Say 'y' here if you want to build support for semaphore's.

config PREEMPT
	bool "CPU preemption"
	depends on SYS_RR || SYS_EDF
	help
	  Say 'y' here to enable preemption. Preemption allows
	  the scheduler to preempt the currently running task at
	  any given moment.

config PREEMPT_FULL
	bool "Full CPU preemption"
	depends on PREEMPT
	help
	  Say 'y' here to enable full CPU preemption. Full CPU preemption
	  means that the scheduler is also called after an interrupt
	  finished its execution.

config TIME_SLICE
	int "Time slice"
	default 10
	depends on PREEMPT
	help
	  Configure the time slice of threads. The time slice defines
	  a period of time which threads have to execute a piece of
	  code. After that time has expired, the system will give another
	  thread CPU time.

config IDLE_SLEEP
	bool "Idle thread power saving"
	depends on ARCH_POWER_SAVE
	default y
	help
	  Say 'y' here to enter power saving mode when the idle thread
	  is executed. If you are unsure, say 'y' here; the only reason
	  to not say 'y' here is due to the slight performance loss from
	  having to wake up the CPU.
```
