## Kconfig
```kconfig
mainmenu "ETA/OS $ARCH Kernel Configuration"

config SRCARCH
	string
	option env="SRCARCH"

config MODULES
	bool "Module building"
	option modules
	help
	  Enable the building of modules.

source "Kconfig.optimisation"

config CROSS_COMPILE
	string "Cross compile prefix"
	help
	  Enter the toolchain cross compile prefix. For example,
	  to cross compile for avr enter avr- here.

source "arch/$SRCARCH/Kconfig"
```

## Kconfig.optimisation
```kconfig
config DEBUG
	bool "ETA/OS debugging"
	help
	  Say 'y' here to enable compiler debugging flags.

choice
	prompt "Compiler optimisation"
	default OPTIMIZE_SIZE
	depends on !DEBUG
	help
	  Select the compiler optimisation level.

config OPTIMIZE_O2
	bool "Default"
	help
	  Use the default O2 optimisation.

config OPTIMIZE_O3
	bool "Full"
	help
	  Use the O3 optimisation to optimise for speed.

config OPTIMIZE_FAST
	bool "Fast"
	help
	  Use the Ofast optimisation to get all possible speed optimisations.

config OPTIMIZE_SIZE
	bool "Size"
	help
	  Use the 'Os' optimisation to optimise for size.
endchoice
```

## arch/avr/Kconfig
```kconfig
menu "AVR system configuration"

config EXT_MEM
	bool "External memory interface"
	default n
	help
	  Say 'y' here to build support for the external
	  memory interface.

if EXT_MEM
config EXT_MEM_SIZE
	int "External memory"
	help
	  If you connected external memory to your AVR core,
	  enter the amount of bytes you connected here.

config EXT_MEM_ENABLE_PIN
	int "External memory enable pin"
	help
	  The pin that enables the external memory interface.
	  Note that this pin is _not_ a platform pin!
endif

config HAVE_PWM0
	bool
config HAVE_PWM1
	bool
config HAVE_PWM2
	bool
config HAVE_PWM3
	bool
config ARCH_PWM
	bool
config HAVE_USART1
	bool

config INIT_STACK_SIZE
	int "Init stack size"
	depends on SCHED
	help
	  The size of the the stack that is used during the
	  system initialisation process.

config STACK_SIZE
	int "Stack size"
	help
	  Enter the amount of bytes which should be
	  reserved for the stack by default. This value
	  will be the size of the main thread (if scheduling
	  is enabled) and it will be used as default for
	  other threads if no stack size is given when a new
	  thread is created.

config IDLE_STACK_SIZE
	int "Idle stack size"
	depends on SCHED
	default 256
	help
	  Set the size of the idle stack. The idle stack
	  takes a seperate number from the main stack, due
	  to the fact that the idle stack is much smaller.

config IRQ_STACK_SIZE
	int "Threaded IRQ stack size"
	depends on IRQ_THREAD
	default 768
	help
	  Set the size for the stacks of threaded IRQ's. Please
	  note that the stacks of threaded IRQ's are generally
	  a tad bigger than normal threads.

config FCPU
	int "CPU frequency"
	default 8000000
	help
	  Enter the frequency your CPU will be running on here.

config SIMUL_AVR
	bool "Enable SIMULAVR support"
	select VFS
	help
	  By saying 'Y' here you will enable support for SIMUALAVR;
	  an AVR emulator. This will also enable two extra I/O
	  registers for input and output. All in- and output from the
	  std C library will be directed from and to these to I/O ports.
	  If unsure, say 'N' here.

choice
	prompt "STDIO output device"
	depends on CRT
	help
	  Select which device driver should be used to drive
	  the STDIO library. By default the USART is selected.

config STDIO_SIMUL_AVR
	bool "STDIO simulavr driver"
	depends on SIMUL_AVR
	help
	  Select if you want to use the special output registers
	  of simulavr to drive the STDIO library.

config STDIO_USART
	bool "STDIO USART driver"
	depends on USART
	help
	  Select if you want to use the USART registers
	  to drive the STDIO library. If unsure say 'y' here.

endchoice

config LIBFLT
	tristate "Floating point library"
	depends on m
	default m
	help
	  By saying 'm' here you enable the floating point
	  built-in library. You should only say 'm' here if
	  gcc is not build with soft-fp (which isn't the case
	  by default). If you unsure say 'm' here.

choice
	prompt "AVR core selection"
	help
	  Select the AVR architecture to build for.

config ATMEGA328
	bool "ATmega 328(p)"
	select ARCH_CLEAR_BIT
	select ARCH_TNC
	select ARCH_TNS
	select ARCH_SET_BIT
	select ARCH_TEST_BIT
	select ARCH_HRTIMER
	select HAVE_PWM0
	select HARVARD
	help
	  Select if you are building for the Atmel ATmega328 or ATmega328p
	  AVR core.

config ATMEGA1280
	bool "ATmega 1280"
	select ARCH_CLEAR_BIT
	select ARCH_TNC
	select ARCH_TNS
	select ARCH_SET_BIT
	select ARCH_TEST_BIT
	select ARCH_HRTIMER
	select HAVE_PWM0
	select HAVE_PWM1
	select HAVE_PWM2
	select HAVE_PWM3
	select HAVE_USART1
	select HARVARD
	help
	  Select if you are building for the Atmel ATmega328 or ATmega1280
	  AVR core.

config ATMEGA2560
	bool "ATmega 2560"
	select ARCH_CLEAR_BIT
	select ARCH_TNC
	select ARCH_TNS
	select ARCH_SET_BIT
	select ARCH_TEST_BIT
	select ARCH_HRTIMER
	select HAVE_PWM0
	select HAVE_PWM1
	select HAVE_PWM2
	select HAVE_PWM3
	select HAVE_USART1
	select HARVARD
	help
	  Select if you are building for the Atmel ATmega328 or ATmega2560
	  AVR core.
endchoice

config PICO_POWER
	bool "Pico power"
	depends on ATMEGA328
	help
	  Select if you are building for the pico power variant
	  of your CPU. Do not select this option of you are not
	  planning to run on a pico power CPU.

config ARCH_POWER_SAVE
	bool "Power saving"
	default y
	help
	  Selecting this options enables the use of the power saving
	  module for AVR MCU's. If you are unsure, say 'y' here.
endmenu

source "kernel/Kconfig"
source "drivers/Kconfig"
source "mm/Kconfig"
source "lib/Kconfig"
source "fs/Kconfig"
```

## arch/avr/configs/atmega2560_defconfig
```kconfig
CONFIG_CROSS_COMPILE="avr-"
CONFIG_EXT_MEM=0
CONFIG_STACK_SIZE=256
CONFIG_FCPU=16000000
CONFIG_ATMEGA2560=y
# CONFIG_CPP is not set
# CONFIG_DRIVER_CORE is not set
```

## arch/avr/configs/atmega328p_defconfig
```kconfig
CONFIG_CROSS_COMPILE="avr-"
CONFIG_EXT_MEM=0
CONFIG_STACK_SIZE=150
CONFIG_FCPU=16000000
CONFIG_PICO_POWER=y
# CONFIG_CPP is not set
# CONFIG_DRIVER_CORE is not set
```

## drivers/Kconfig
```kconfig
menu "Device drivers"

source "drivers/core/Kconfig"

source "drivers/usart/Kconfig"

source "drivers/spi/Kconfig"

source "drivers/i2c/Kconfig"

source "drivers/gpio/Kconfig"

source "drivers/analog/Kconfig"

source "drivers/platform/Kconfig"

source "drivers/eeprom/Kconfig"

source "drivers/sram/Kconfig"

endmenu
```

## drivers/analog/Kconfig
```kconfig
menuconfig ANALOG
	tristate "ADC"
	help
	  Say 'y' or 'm' here to build the analog to digital converter
	  module. If unsure, say 'm' here.

if ANALOG

config ATMEGA_ANALOG
	tristate "ATmega ADC"
	depends on ANALOG
	help
	  Say 'y' or 'm' here to build the AVR ATmega ADC module.

endif
```

## drivers/core/Kconfig
```kconfig
menuconfig DRIVER_CORE
	tristate "Device driver core"
	select MALLOC
	default y
	help
	  Enable or disable the device driver core. If you're not
	  sure, say 'Y' here.

if DRIVER_CORE

config DRIVER_DBG
	bool "Driver core debugging"
	depends on DRIVER_CORE
	help
	  Say 'Y' here if you want to enable the device driver
	  debugging code.

endif
```

## drivers/eeprom/Kconfig
```kconfig
menuconfig EEPROM
	tristate "EEPROM support"
	help
	  Say 'y' or 'm' here to build support for EEPROM chips.

if EEPROM

config 24C02
	tristate "AT24C02 EEPROM chip"
	depends on I2C
	help
	  Say 'y' or 'm' here to build support for the Atmel 24C02
	  EEPROM chip. If you are unsure say 'n' here.

endif
```

## drivers/flash/Kconfig
```kconfig
menuconfig FLASH
	tristate "HARVARD flash"
	help
	  Say 'y' or 'm' here to build support for HARVARD flash
	  drivers.

if FLASH
config ATMEGA_FLASH
	tristate "ATmega flash"
	depends on FLASH
	help
	  Say 'y' or 'm' here to build support for the HARVARD flash
	  drivers.
endif
```

## drivers/gpio/Kconfig
```kconfig
menuconfig GPIO
	tristate "GPIO driver"
	help
	  Say 'y' or 'm' here if you want to build support for the GPIO
	  layer.

if GPIO

config ATMEGA_GPIO
	tristate "ATmega GPIO"
	help
	  Say 'y' or 'm' here to build support for the AVR ATmega GPIO
	  chip.

config GPIO_LOW_FOOTPRINT
	bool "Low memory footprint"
	help
	  Say 'y' here to reduce the memory usage of the GPIO drivers to
	  an absolute minimum.

endif
```

## drivers/i2c/Kconfig
```kconfig
menuconfig I2C
	tristate "I2C driver"
	help
	  Say 'y' or 'm' here to build support for I2C devices.

if I2C

config I2C_ATMEGA
	tristate "ATmega I2C driver"
	help
	  Say 'y' or 'm' here to build the ATmega I2C driver. If you
	  are unsure and building for an ATmega AVR target say 'm'
	  here.
endif
```

## drivers/platform/Kconfig
```kconfig
menu "Platform drivers"

config ARD_UNO
	bool "Arduino uno"
	depends on ATMEGA_GPIO && ATMEGA328
	help
	  Say 'y' here to build support for the Arduiono UNO
	  development board.

config ARD_MEGA
	bool "Arduino mega"
	depends on ATMEGA_GPIO && ATMEGA2560
	help
	  Say 'y' here to build support for the Arduino MEGA
	  development board.

endmenu
```

## drivers/pwm/Kconfig
```kconfig
menuconfig PWM
	tristate "PWM drivers"
	depends on GPIO
	help
	  Say 'y' here to build support for the PWM bus. If your chip doesn't
	  support PWM, say 'n' here.

if PWM
config ATMEGA_PWM
	tristate "ATmega PWM driver"
	select ARCH_PWM
	help
	  Say 'y' here to build support for the ATmega PWM bus.
if ATMEGA_PWM
config PWM0
	depends on HAVE_PWM0
	bool "Enable PWM0"

config PWM1
	depends on HAVE_PWM1
	bool "Enable PWM1"

config PWM2
	depends on HAVE_PWM2
	bool "Enable PWM2"

config PWM3
	depends on HAVE_PWM3
	bool "Enable PWM3"

endif
endif
```

## drivers/sensors/Kconfig
```kconfig
menu "Sensor drivers"
config DHT11
	tristate "DHT sensor"
	depends on GPIO && DELAY_US
	help
	  Say 'y' or 'm' here to build support for the DHT temperature sensor.

config BMP085
	tristate "BMP085 sensor"
	depends on I2C
	help
	  Say 'y' or 'm' here to build support for the BMP085 barometric sensor.
endmenu
```

## drivers/spi/Kconfig
```kconfig
menuconfig SPI
	tristate "SPI drivers"
	depends on GPIO
	help
	  Say 'y' here if you want to build support for SPI bus drivers. If
	  your chip doesn't have such a bus, say 'N' here. If you are unsure,
	  say 'm'.

if SPI

config ATMEGA_SPI
	tristate "ATmega SPI driver"
	help
	  Say 'y' or 'm' here to build support for the ATmega SPI driver.

endif
```

## drivers/sram/Kconfig
```kconfig
menuconfig SRAM
	tristate "SRAM support"
	help
	  Say 'y' or 'm' here to build support for external SRAM chips,
	  usually conntected through I2C or SPI. If you are unsure say
	  'n' here.

if SRAM

config 23K256
	tristate "23K256 SPI SRAM chip"
	depends on SPI
	help
	  Say 'y' or 'm' here to build a driver for the 23K256
	  external SRAM chip. If you are unsure say 'n' here.

config 23K256_SS
	int "23K256 slave select pin"
	depends on 23K256
	help
	  Enter the GPIO number which is to be used as the slave
	  select pin by the SPI driver to select the 23K256 SRAM chip
	  in your hardware configuration.

config 23K256_SPEED
	int "23K256 bit rate (bps)"
	depends on 23K256
	help
	  Enter the bitrate for the 23K256 SPI transmissions here. This
	  value should be 20Mhz or less.

endif
```

## drivers/usart/Kconfig
```kconfig
menuconfig USART
	tristate "USART support"
	help
	  Say 'y' here if you want to build support
	  for USARTs.

if USART
config ATMEGA_USART
	tristate "ATmega USART module"
	depends on USART
	help
	  Say 'y' here if you are planning on using the USART
	  controller on an ATmega AVR.

config USART_BAUD
	int "ATmega USART baud"
	default 9600
	depends on ATMEGA_USART
	help
	  Set the baud rate of the default USART.

config ATMEGA_USART1
	tristate "ATmega USART1 module"
	depends on USART && HAVE_USART1
	help
	  Say 'y' or 'm' here to build the USART1 drivers.

config USART1_BAUD
	int "USART1 baud rate"
	depends on ATMEGA_USART1
	help
	  Set the default USART1 baudrate in bits/s.
endif
```

## fs/Kconfig
```kconfig
menu "File systems"

config VFS
	tristate "Virtual Filesystem"
	help
	  If set to 'y', the virtual filesystem driver
	  will be compiled. The virtual file system is
	  used by the standard C library for the STDIO
	  functions. If you are unsure say 'm' or 'y'
	  here.

if VFS
config DEVFS
	tristate "Device file system"
	depends on VFS
	help
	  Device file system. This file system is used by the device
	  drivers to create a UAPI for applications.

config ROMFS
	tristate "Micro ROM filesystem"
	help
	  Say 'y' or 'm' here to build a small read-only
	  filesystem. This filesystem is stored in program
	  memory. If you are unsure, say 'n' here.

config RAMFS
	tristate "Micro RAM filesystem"
	default n
	help
	  Say 'y' or 'm' here to build a small RAM read-write
	  filesystem. If you are unsure, say 'n' here.
endif
endmenu
```

## kernel/Kconfig
```kconfig
config ARCH_TEST_BIT
	bool

config ARCH_TNC
	bool

config ARCH_TNS
	bool

config ARCH_SET_BIT
	bool

config ARCH_CLEAR_BIT
	bool

config ARCH_TEST_BIT
	bool

config HARVARD
	bool

menu "Generic system configuration"

config CPP
	bool "C++ supoort"
	default y
	help
	  Say 'y' here to build support for the C++ programming
	  language. If you are unsure, say leave this option set
	  to 'y'.

config TRACE_INFO
	bool "Call tracing"
	depends on CRT
	default n
	help
	  Say 'y' here to build support for function call tracing.

source "kernel/python/Kconfig"

source "kernel/irq/Kconfig"

source "kernel/time/Kconfig"

source "kernel/sched/Kconfig"

config SPINLOCK_DEBUG
	depends on CRT
	select TRACE_INFO
	bool "Spinlock tracing"
	help
	  Say 'y' here to built support for spinlock tracing.

endmenu
```

## kernel/irq/Kconfig
```kconfig
menuconfig IRQ_SUPPORT
	bool "IRQ core"
	select MALLOC
	help
	  Say 'y' here if you want to enable support
	  IRQ chips. If you are unsure say 'y'.

if IRQ_SUPPORT
config IRQ_THREAD
	bool "Threaded IRQ support"
	depends on SCHED && THREAD_QUEUE && EVENT_MUTEX
	help
	  Say 'y' here if you want to have the ability to
	  handle threads out of IRQ context. Triggered IRQ's will
	  execute (delayed) in a thread. The drawbacks are that
	  these kind of interrupts arrive delayed and have extra
	  overhead in the kernel. If unsure say 'n' here.

config SOFT_IRQ
	bool "Software IRQs"
	depends on GPIO
	help
	  Say 'y' here to build support for software IRQ triggering. If
	  you are unsure, say 'n' here.

config IRQ_DEBUG
	bool "Threaded IRQ debug support"
	depends on IRQ_THREAD
	help
	  Say 'y' here if you want to build debugging symbols for IRQ
	  threads. This option is useful for ETA/OS developers. If you are
	  unsure say 'N' here.
endif
```
